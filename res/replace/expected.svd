# STM32L4x2 register map
Registers are 32-bit, read-write, reset 0x0 unless marked. A register's access mark holds for its fields unless they carry their own. Offsets are from the block's base; lines under a group give offsets from that group; [hi:lo] are bit positions; {n}, {i} and the like mark numbered series; 'fields as' and 'values as' point back to an identical list; <NAME> marks a mode.

## Memory map
0x40007400 DAC1 size 0x400 — Digital-to-analog converter
0x40007400 DAC2 size 0x400 — Digital-to-analog converter
0x40007400 DAC3 size 0x400 — Digital-to-analog converter

## DAC1 — Digital-to-analog converter
Base 0x40007400
0x00 CR
  [0] EN1 — DAC channel1 enable
    0=CH1_STATE_DISABLED; 1=CH1_STATE_ENABLED

## DAC2 — Digital-to-analog converter
Base 0x40007400
Same registers: DAC3 0x40007400
0x00 CR — control register
  [0] EN1 — DAC channel1 enable
