# ESP32S3 register map
Registers are 32-bit, read-write, reset 0x8000 unless marked. A register's access mark holds for its fields unless they carry their own. Offsets are from the block's base; lines under a group give offsets from that group; [hi:lo] are bit positions; {n}, {i} and the like mark numbered series; 'fields as' and 'values as' point back to an identical list; <NAME> marks a mode.

## Memory map
0x60080000 USB0 size 0x2A0 — USB OTG (On-The-Go)

## USB0 — USB OTG (On-The-Go)
Base 0x60080000
0x900 IN_EP0 group — Device IN Endpoint 0
  0x00 DIEPCTL
    [1:0] MPS
  0x08 DIEPINT reset not defined
    [0] XFERCOMPL
{0x900+0x20*i} IN_EP{i} (i=1..2) group — Device IN Endpoints 1-6
  0x00 DIEPCTL
    [10:0] MPS
  0x08 DIEPINT reset not defined
    [0] XFERCOMPL
